## arch/arm/hotplug/Kconfig
```kconfig
config MAKO_HOTPLUG
    bool "mako hotplug driver"
    default n
    help
      easy HOTPLUG driver made by franciscofranco

config MSM_HOTPLUG
    bool "MSM hotplug driver"
    depends on HOTPLUG_CPU
    default y
    help
      The MSM hotplug driver controls on-/offlining of additional cores based
      on current cpu load.
```
